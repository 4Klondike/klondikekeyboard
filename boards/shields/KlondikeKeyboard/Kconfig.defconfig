## boards/shields/KlondikeKeyboard/Kconfig.defconfig
```kconfig
if SHIELD_KLONDIKEKEYBOARD
    config ZMK_KEYBOARD_NAME
        default "klondikekeyboard"

endif
```

## boards/shields/klondikekeyboard/Kconfig.shield
```kconfig
config SHIELD_KLONDIKEKEYBOARD
    def_bool $(shields_list_contains,klondikekeyboard)
    select GPIO
```

## boards/shields/klondikekeybord/Kconfig.defconfig
```kconfig
if SHIELD_KLONDIKEKEYBORD
    config ZMK_KEYBOARD_NAME
        default "klondikekeybord"

endif
```

## boards/shields/klondikekeybord/Kconfig.shield
```kconfig
config SHIELD_KLONDIKEKEYBORD
    def_bool $(shields_list_contains,klondikekeybord)
    select GPIO
```
